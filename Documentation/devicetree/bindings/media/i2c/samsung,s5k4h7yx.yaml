## Documentation/devicetree/bindings/media/i2c/samsung,s5k4h7yx.yaml
```yaml
# SPDX-License-Identifier: (GPL-2.0-only OR BSD-2-Clause)
%YAML 1.2
---
$id: http://devicetree.org/schemas/media/i2c/samsung,s5k4h7yx.yaml#
$schema: http://devicetree.org/meta-schemas/core.yaml#

title: Samsung S5K4H7YX Image Sensor

maintainers:
  - Marc Zyngier <maz@kernel.org>

description:
  The Samsung S5K4H7YX is a 1/4-inch CMOS active pixel digital image sensor
  with an active array size of 3264H x 2448V. It is programmable through I2C
  (CCI) interface. Image data is sent through MIPI CSI-2 using 4 data lanes
  at 10 bits per pixel.

properties:
  compatible:
    const: samsung,s5k4h7yx

  reg:
    maxItems: 1

  clocks:
    maxItems: 1

  clock-frequency:
    description: Input clock frequency in Hz. Must be 24000000.
    const: 24000000

  assigned-clocks: true
  assigned-clock-parents: true
  assigned-clock-rates: true

  vana-supply:
    description: Analog voltage (VANA) supply, 2.8V.

  vdig-supply:
    description: Digital core voltage (VDIG) supply, 1.2V.

  vif-supply:
    description: Interface voltage (VIF) supply, 1.8V.

  reset-gpios:
    description: Reference to the GPIO connected to the XSHUTDOWN (reset) pin.
    maxItems: 1

  rotation:
    enum: [0, 90, 180, 270]

  orientation:
    enum: [0, 1, 2]

  port:
    additionalProperties: false
    $ref: /schemas/graph.yaml#/$defs/port-base

    properties:
      endpoint:
        $ref: /schemas/media/video-interfaces.yaml#
        unevaluatedProperties: false

        properties:
          data-lanes:
            minItems: 4
            maxItems: 4

          link-frequencies:
            maxItems: 1

        required:
          - data-lanes
          - link-frequencies

    required:
      - endpoint

required:
  - compatible
  - reg
  - clocks
  - port

additionalProperties: false

examples:
  - |
    #include <dt-bindings/gpio/gpio.h>

    i2c {
        #address-cells = <1>;
        #size-cells = <0>;

        camera-sensor@10 {
            compatible = "samsung,s5k4h7yx";
            reg = <0x10>;

            clocks = <&gcc 27>;
            clock-frequency = <24000000>;

            reset-gpios = <&tlmm 129 GPIO_ACTIVE_LOW>;

            vana-supply = <&cam_vana>;
            vdig-supply = <&cam_vdig>;
            vif-supply = <&cam_vif>;

            rotation = <270>;
            orientation = <0>;

            port {
                s5k4h7yx_ep: endpoint {
                    data-lanes = <0 1 2 3>;
                    link-frequencies = /bits/ 64 <350000000>;
                    remote-endpoint = <&csiphy_ep>;
                };
            };
        };
    };
...
```

## Documentation/devicetree/bindings/media/i2c/sony,imx363.yaml
```yaml
# SPDX-License-Identifier: (GPL-2.0-only OR BSD-2-Clause)
%YAML 1.2
---
$id: http://devicetree.org/schemas/media/i2c/sony,imx363.yaml#
$schema: http://devicetree.org/meta-schemas/core.yaml#

title: Sony IMX363 Image Sensor

maintainers:
  - Luca Weiss <luca@z3ntu.xyz>

description:
  The Sony IMX363 is a 1/2.55-inch CMOS active pixel digital image sensor with
  an active array size of 4032H x 3024V. It is programmable through I2C (CCI)
  interface. The I2C client address is fixed to 0x1a. Image data is sent
  through MIPI CSI-2 using 4 data lanes.

properties:
  compatible:
    const: sony,imx363

  reg:
    maxItems: 1

  clocks:
    maxItems: 1

  clock-frequency:
    description: Input clock frequency in Hz. Must be 24000000.
    const: 24000000

  assigned-clocks: true
  assigned-clock-parents: true
  assigned-clock-rates: true

  vana-supply:
    description: Analog voltage (VANA) supply, 2.8V.

  vdig-supply:
    description: Digital core voltage (VDIG) supply, 1.2V.

  vif-supply:
    description: Interface voltage (VIF) supply, 1.8V.

  reset-gpios:
    description: Reference to the GPIO connected to the XCLR (reset) pin.
    maxItems: 1

  flash-leds:
    description: Phandle to associated flash LED device.
    maxItems: 1

  lens-focus:
    description: Phandle to associated lens focus device.
    maxItems: 1

  rotation:
    enum: [0, 90, 180, 270]

  orientation:
    enum: [0, 1, 2]

  port:
    additionalProperties: false
    $ref: /schemas/graph.yaml#/$defs/port-base

    properties:
      endpoint:
        $ref: /schemas/media/video-interfaces.yaml#
        unevaluatedProperties: false

        properties:
          data-lanes:
            minItems: 4
            maxItems: 4

          link-frequencies:
            minItems: 1
            maxItems: 3

        required:
          - data-lanes
          - link-frequencies

    required:
      - endpoint

required:
  - compatible
  - reg
  - clocks
  - port

additionalProperties: false

examples:
  - |
    #include <dt-bindings/gpio/gpio.h>

    i2c {
        #address-cells = <1>;
        #size-cells = <0>;

        camera-sensor@1a {
            compatible = "sony,imx363";
            reg = <0x1a>;

            clocks = <&gcc 26>;
            clock-frequency = <24000000>;

            reset-gpios = <&tlmm 40 GPIO_ACTIVE_LOW>;

            vana-supply = <&cam_vana>;
            vdig-supply = <&cam_vdig>;
            vif-supply = <&cam_vif>;

            rotation = <270>;
            orientation = <1>;

            port {
                imx363_ep: endpoint {
                    data-lanes = <0 1 2 3>;
                    link-frequencies = /bits/ 64 <620000000>;
                    remote-endpoint = <&csiphy0_ep>;
                };
            };
        };
    };
...
```
